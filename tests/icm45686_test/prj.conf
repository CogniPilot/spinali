## prj.conf
```kconfig
CONFIG_ZTEST=y              # Is needed by ZTEST in order to work
CONFIG_SENSOR=y             # Is needed by sensor.h in order to work
# CONFIG_ICM45686_SELFTEST_EN=y      # Enable Self-test
```

## mr_mcxn_t1_oflo.overlay
```dts
/* SPDX-License-Identifier: Apache-2.0 */
/* Copyright 2025 CogniPilot Foundation */

/ {
	aliases {
		icm45686 = &icm45686_1;
	};
};

&icm45686_1 {
	spi-max-frequency = <20000000>;
	accel-pwr-mode = <ICM45686_DT_ACCEL_LN>;
	accel-fs = <ICM45686_DT_ACCEL_FS_2>;
	accel-odr = <ICM45686_DT_ACCEL_ODR_400>;
	accel-lpf = <ICM45686_DT_ACCEL_LPF_BW_1_32>;
	gyro-pwr-mode = <ICM45686_DT_GYRO_LN>;
	gyro-fs = <ICM45686_DT_GYRO_FS_4000>;
	gyro-odr = <ICM45686_DT_GYRO_ODR_400>;
	gyro-lpf = <ICM45686_DT_GYRO_LPF_BW_1_32>;
};
```

## boards/mr_mcxn_t1_mcxn947_cpu0.overlay
```dts
/* SPDX-License-Identifier: Apache-2.0 */
/* Copyright 2025 CogniPilot Foundation */

/ {
	aliases {
		icm45686 = &icm45686_0;
	};
};

&icm45686_0 {
	spi-max-frequency = <20000000>;
	accel-pwr-mode = <ICM45686_DT_ACCEL_LN>;
	accel-fs = <ICM45686_DT_ACCEL_FS_32>;
	accel-odr = <ICM45686_DT_ACCEL_ODR_6400>;
	accel-lpf = <ICM45686_DT_ACCEL_LPF_BW_1_32>;
	gyro-pwr-mode = <ICM45686_DT_GYRO_LN>;
	gyro-fs = <ICM45686_DT_GYRO_FS_4000>;
	gyro-odr = <ICM45686_DT_GYRO_ODR_6400>;
	gyro-lpf = <ICM45686_DT_GYRO_LPF_BW_1_32>;
	status = "okay";
};

&icm45686_1 {
	spi-max-frequency = <20000000>;
	accel-pwr-mode = <ICM45686_DT_ACCEL_LN>;
	accel-fs = <ICM45686_DT_ACCEL_FS_32>;
	accel-odr = <ICM45686_DT_ACCEL_ODR_6400>;
	accel-lpf = <ICM45686_DT_ACCEL_LPF_BW_1_32>;
	gyro-pwr-mode = <ICM45686_DT_GYRO_LN>;
	gyro-fs = <ICM45686_DT_GYRO_FS_4000>;
	gyro-odr = <ICM45686_DT_GYRO_ODR_6400>;
	gyro-lpf = <ICM45686_DT_GYRO_LPF_BW_1_32>;
	status = "okay";
};
```

## src/main.c
```c
#include <zephyr/kernel.h>
#include <zephyr/device.h>
#include <zephyr/drivers/sensor.h>
#include <zephyr/ztest.h>

#define ICM45686_COMPAT invensense_icm45686

/// @brief ICM45686 device ready test
/// @param dev Device struct
static void test_icm45686_rdy(const struct device *dev)
{
    printk("Running test for device: %s\n", dev->name);
    zassert_true(device_is_ready(dev), "Device is not ready");
}

/// @brief ICM45686 fetch and get accelerometer, gyro and die temperature data
/// @param dev Device struct
static void test_icm45686_data(const struct device *dev)
{
    struct sensor_value acc[3], gyr[3], die_temp[1];
    int err;

    err = sensor_sample_fetch(dev);
    zassert_equal(err, 0, "ICM45686 could not fetch data (err %d)", err);

    err = sensor_channel_get(dev, SENSOR_CHAN_ACCEL_XYZ, acc);
    zassert_equal(err, 0, "ICM45686 could not get accel data (err %d)", err);

	err = sensor_channel_get(dev, SENSOR_CHAN_GYRO_XYZ, gyr);
    zassert_equal(err, 0, "ICM45686 could not get gyro data (err %d)", err);

    err = sensor_channel_get(dev, SENSOR_CHAN_DIE_TEMP, die_temp);
    zassert_equal(err, 0, "ICM45686 could not get die temperature data (err %d)", err);

    printf("%s: \t AX: %d.%06d; AY: %d.%06d; AZ: %d.%06d; "
		       "GX: %d.%06d; GY: %d.%06d; GZ: %d.%06d; "
               "Temp: %d.%06d; \n",
			   dev->name,
		       acc[0].val1, acc[0].val2,
		       acc[1].val1, acc[1].val2,
		       acc[2].val1, acc[2].val2,
		       gyr[0].val1, gyr[0].val2,
		       gyr[1].val1, gyr[1].val2,
		       gyr[2].val1, gyr[2].val2,
               die_temp[0].val1, die_temp[0].val2);
}

// Macro that allows test suites with tests to be created for each ICM45686 device within a board
#define ICM45686_DEVICE_INIT(n) \
    const struct device *dev_##n = DEVICE_DT_GET(n); \
    ZTEST(icm45686_##n, test_icm45686_rdy) { test_icm45686_rdy(dev_##n); } \
    ZTEST(icm45686_##n, test_icm45686_data) { test_icm45686_data(dev_##n); } \
    ZTEST_SUITE(icm45686_##n, NULL, NULL, NULL, NULL, NULL); \

// Loop through all device ids that are compatible with the invensense ICM45686
DT_FOREACH_STATUS_OKAY(ICM45686_COMPAT, ICM45686_DEVICE_INIT);
```
