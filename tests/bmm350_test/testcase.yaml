## tests/bmm350_test/testcase.yaml
```yaml
common:
  tags:
    - drivers
    - sensor
tests:
  drivers.sensor.bmm350:
    filter: CONFIG_BMM350
    build_only: false
```

## tests/bmp581_test/testcase.yaml
```yaml
common:
  tags:
    - drivers
    - sensor
tests:
  drivers.sensor.bmp581:
    filter: CONFIG_BMP581
    build_only: false
```

## tests/icm42688_test/testcase.yaml
```yaml
common:
  tags:
    - drivers
    - sensor
tests:
  drivers.sensor.icm42688:
    filter: CONFIG_ICM4268X
    build_only: false
```

## tests/icm45686_test/testcase.yaml
```yaml
common:
  tags:
    - drivers
    - sensor
tests:
  drivers.sensor.icm45686:
    filter: CONFIG_ICM45686
    build_only: false
```

## tests/optical_flow_test/testcase.yaml
```yaml
common:
  tags:
    - mr_mcxn_t1
  platform_allow: mr_mcxn_t1/mcxn947/cpu0
tests:
  spinali.mr_mcxn_t1:
    # platform_allow: mr_mcxn_t1/mcxn947/cpu0
    # platform_allow: frdm_mcxn947/mcxn947/cpu0
    # tags: mr_mcxn_t1
    depends_on: can
    filter: CONFIG_ICM4268X and CONFIG_ICM45686
    build_only: false

  spinali.mr_mcxn_t1.oflo:
    # platform_allow: mr_mcxn_t1/mcxn947/cpu0
    tags: 
      # - mr_mcxn_t1 
      - oflo
    extra_configs: 
      - CONFIG_OFLO_ADDON=y
    build_only: false
```

## tests/paa3905_test/testcase.yaml
```yaml
common:
  tags:
    - drivers
    - sensor
tests:
  drivers.sensor.paa3905:
    filter: CONFIG_PAA3905
    build_only: false
```
