## drivers/synapse/vesc_can/Kconfig
```kconfig
# Copyright (c) 2023, CogniPilot Foundation
# SPDX-License-Identifier: Apache-2.0

menuconfig SPINALI_SYNAPSE_VESC_CAN
  bool "VESC CAN"
  depends on CAN
  help
    This option enables configuring VESC CAN

if SPINALI_SYNAPSE_VESC_CAN

config SPINALI_SYNAPSE_VESC_CAN_STATUS
  bool "VESC CAN based status"
  depends on CAN
  help
    This option enables status messages for CAN VESC

config SPINALI_SYNAPSE_VESC_CAN_NUMBER
  int "Number of VESC CAN actuators"
  default 1
  range 1 8
  depends on SPINALI_ACTUATE_VESC_CAN || SPINALI_SYNAPSE_VESC_CAN_STATUS
  help
    Defines number of SPINALI_SYNAPSE_VESC CAN actuators 1-8

if SPINALI_ACTUATE_VESC_CAN || SPINALI_SYNAPSE_VESC_CAN_STATUS
menu "SPINALI_SYNAPSE_VESC_CAN_0"

config SPINALI_SYNAPSE_VESC_CAN_BUS_ALIAS_CAN_N_0
  int "CAN bus alias CAN# for SPINALI_SYNAPSE_VESC 0"
  default 0
  depends on SPINALI_ACTUATE_VESC_CAN || SPINALI_SYNAPSE_VESC_CAN_STATUS
  help
    CAN bus device alias name can(number) that connects to SPINALI_SYNAPSE_VESC 0.

config SPINALI_SYNAPSE_VESC_CAN_BUS_FD_0
  bool "CAN bus is CANFD for SPINALI_SYNAPSE_VESC 0"
  depends on SPINALI_ACTUATE_VESC_CAN || SPINALI_SYNAPSE_VESC_CAN_STATUS
  depends on CAN_FD_MODE
  help
    This option sets the CAN bus to use CANFD for 
    device bus

config SPINALI_SYNAPSE_VESC_POLE_PAIR_0
  int "Number of Pole Pairs of motor attached to SPINALI_SYNAPSE_VESC 0"
  default 15
  range 1 128
  depends on SPINALI_ACTUATE_VESC_CAN || SPINALI_SYNAPSE_VESC_CAN_STATUS
  help
    Number of Pole Pairs of motor attached to SPINALI_SYNAPSE_VESC 0.

config SPINALI_SYNAPSE_VESC_CAN_ID_0
  int "ID of SPINALI_SYNAPSE_VESC 0"
  default 0
  range 0 255
  depends on SPINALI_ACTUATE_VESC_CAN || SPINALI_SYNAPSE_VESC_CAN_STATUS
  help
    ID assigned to SPINALI_SYNAPSE_VESC 0.

config SPINALI_SYNAPSE_VESC_CAN_ACTUATOR_VEL_IDX_0
  int "Actuator velocity index for SPINALI_SYNAPSE_VESC 0"
  default 0
  range 0 15
  depends on SPINALI_ACTUATE_VESC_CAN
  help
    Actuator velocity index for SPINALI_SYNAPSE_VESC 0.

config SPINALI_SYNAPSE_VESC_STATUS_BITMASK_0
  int "bitmask for SPINALI_SYNAPSE_VESC status message subscription"
  default 1
  range 0 63
  depends on SPINALI_SYNAPSE_VESC_CAN_STATUS
  help
    bitmask for SPINALI_SYNAPSE_VESC CAN status messages [ STAT6 STAT5 STAT4 STAT3 STAT2 STAT1 ]
    IE setting status message 4 and 1 would be 0b001001 = 9
    If no status desired set to 0 for it to skip

endmenu

endif

if SPINALI_SYNAPSE_VESC_CAN_NUMBER > 1

menu "SPINALI_SYNAPSE_VESC_CAN_1"

config SPINALI_SYNAPSE_VESC_CAN_BUS_ALIAS_CAN_N_1
  int "CAN bus alias CAN# for SPINALI_SYNAPSE_VESC 1"
  default 0
  depends on SPINALI_ACTUATE_VESC_CAN || SPINALI_SYNAPSE_VESC_CAN_STATUS
  help
    CAN bus device alias name can(number) that connects to SPINALI_SYNAPSE_VESC 1.

config SPINALI_SYNAPSE_VESC_CAN_BUS_FD_1
  bool "CAN bus is CANFD for SPINALI_SYNAPSE_VESC 1"
  depends on SPINALI_ACTUATE_VESC_CAN || SPINALI_SYNAPSE_VESC_CAN_STATUS
  depends on CAN_FD_MODE
  help
    This option sets the CAN bus to use CANFD for 
    device bus

config SPINALI_SYNAPSE_VESC_POLE_PAIR_1
  int "Number of Pole Pairs of motor attached to SPINALI_SYNAPSE_VESC 1"
  default 15
  range 1 128
  depends on SPINALI_ACTUATE_VESC_CAN || SPINALI_SYNAPSE_VESC_CAN_STATUS
  help
    Number of Pole Pairs of motor attached to SPINALI_SYNAPSE_VESC 1.

config SPINALI_SYNAPSE_VESC_CAN_ID_1
  int "ID of SPINALI_SYNAPSE_VESC 1"
  default 1
  range 0 255
  depends on SPINALI_ACTUATE_VESC_CAN || SPINALI_SYNAPSE_VESC_CAN_STATUS
  help
    ID assigned to SPINALI_SYNAPSE_VESC 1.

config SPINALI_SYNAPSE_VESC_CAN_ACTUATOR_VEL_IDX_1
  int "Actuator velocity index for SPINALI_SYNAPSE_VESC 1"
  default 1
  range 0 15
  depends on SPINALI_ACTUATE_VESC_CAN
  help
    Actuator velocity index for SPINALI_SYNAPSE_VESC 1.

config SPINALI_SYNAPSE_VESC_STATUS_BITMASK_1
  int "bitmask for SPINALI_SYNAPSE_VESC status message subscription"
  default 1
  range 0 63
  depends on SPINALI_SYNAPSE_VESC_CAN_STATUS
  help
    bitmask for SPINALI_SYNAPSE_VESC CAN 1 status messages [ STAT6 STAT5 STAT4 STAT3 STAT2 STAT1 ]
    IE setting status message 4 and 1 would be 0b001001 = 9
    If no status desired set to 0 for it to skip

endmenu

endif # SPINALI_SYNAPSE_VESC_CAN_NUMBER > 1

if SPINALI_SYNAPSE_VESC_CAN_NUMBER > 2

menu "SPINALI_SYNAPSE_VESC_CAN_2"

config SPINALI_SYNAPSE_VESC_CAN_BUS_ALIAS_CAN_N_2
  int "CAN bus alias CAN# for SPINALI_SYNAPSE_VESC 2"
  default 0
  depends on SPINALI_ACTUATE_VESC_CAN || SPINALI_SYNAPSE_VESC_CAN_STATUS
  help
    CAN bus device alias name can(number) that connects to SPINALI_SYNAPSE_VESC 2.

config SPINALI_SYNAPSE_VESC_CAN_BUS_FD_2
  bool "CAN bus is CANFD for SPINALI_SYNAPSE_VESC 2"
  depends on SPINALI_ACTUATE_VESC_CAN || SPINALI_SYNAPSE_VESC_CAN_STATUS
  depends on CAN_FD_MODE
  help
    This option sets the CAN bus to use CANFD for 
    device bus

config SPINALI_SYNAPSE_VESC_POLE_PAIR_2
  int "Number of Pole Pairs of motor attached to SPINALI_SYNAPSE_VESC 2"
  default 15
  range 1 128
  depends on SPINALI_ACTUATE_SYNAPSE_VESC_CAN || SPINALI_SYNAPSE_VESC_CAN_STATUS
  help
    Number of Pole Pairs of motor attached to SPINALI_SYNAPSE_VESC 2.

config SPINALI_SYNAPSE_VESC_CAN_ID_2
  int "ID of SPINALI_SYNAPSE_VESC 2"
  default 2
  range 0 255
  depends on SPINALI_ACTUATE_VESC_CAN || SPINALI_SYNAPSE_VESC_CAN_STATUS
  help
    ID assigned to SPINALI_SYNAPSE_VESC 2.

config SPINALI_SYNAPSE_VESC_CAN_ACTUATOR_VEL_IDX_2
  int "Actuator velocity index for SPINALI_SYNAPSE_VESC 2"
  default 2
  range 0 15
  depends on SPINALI_ACTUATE_SYNAPSE_VESC_CAN
  help
    Actuator velocity index for SPINALI_SYNAPSE_VESC 2.

config SPINALI_SYNAPSE_VESC_STATUS_BITMASK_2
  int "bitmask for SPINALI_SYNAPSE_VESC status message subscription"
  default 1
  range 0 63
  depends on SPINALI_SYNAPSE_VESC_CAN_STATUS
  help
    bitmask for SPINALI_SYNAPSE_VESC CAN 2 status messages [ STAT6 STAT5 STAT4 STAT3 STAT2 STAT1 ]
    IE setting status message 4 and 1 would be 0b001001 = 9
    If no status desired set to 0 for it to skip

endmenu

endif # SPINALI_SYNAPSE_VESC_CAN_NUMBER > 2

if SPINALI_SYNAPSE_VESC_CAN_NUMBER > 3

menu "SPINALI_SYNAPSE_VESC_CAN_3"

config SPINALI_SYNAPSE_VESC_CAN_BUS_ALIAS_CAN_N_3
  int "CAN bus alias CAN# for SPINALI_SYNAPSE_VESC 3"
  default 0
  depends on SPINALI_ACTUATE_SYNAPSE_VESC_CAN || SPINALI_SYNAPSE_VESC_CAN_STATUS
  help
    CAN bus device alias name can(number) that connects to SPINALI_SYNAPSE_VESC 3.

config SPINALI_SYNAPSE_VESC_CAN_BUS_FD_3
  bool "CAN bus is CANFD for SPINALI_SYNAPSE_VESC 3"
  depends on SPINALI_ACTUATE_VESC_CAN || SPINALI_SYNAPSE_VESC_CAN_STATUS
  depends on CAN_FD_MODE
  help
    This option sets the CAN bus to use CANFD for 
    device bus

config SPINALI_SYNAPSE_VESC_POLE_PAIR_3
  int "Number of Pole Pairs of motor attached to SPINALI_SYNAPSE_VESC 3"
  default 15
  range 1 128
  depends on SPINALI_ACTUATE_SYNAPSE_VESC_CAN || SPINALI_SYNAPSE_VESC_CAN_STATUS
  help
    Number of Pole Pairs of motor attached to SPINALI_SYNAPSE_VESC 3.

config SPINALI_SYNAPSE_VESC_CAN_ID_2
  int "ID of SPINALI_SYNAPSE_VESC 3"
  default 3
  range 0 255
  depends on SPINALI_ACTUATE_SYNAPSE_VESC_CAN || SPINALI_SYNAPSE_VESC_CAN_STATUS
  help
    ID assigned to SPINALI_SYNAPSE_VESC 3.

config SPINALI_SYNAPSE_VESC_CAN_ACTUATOR_VEL_IDX_3
  int "Actuator velocity index for SPINALI_SYNAPSE_VESC 3"
  default 3
  range 0 15
  depends on SPINALI_ACTUATE_SYNAPSE_VESC_CAN
  help
    Actuator velocity index for SPINALI_SYNAPSE_VESC 3.

config SPINALI_SYNAPSE_VESC_STATUS_BITMASK_3
  int "bitmask for SPINALI_SYNAPSE_VESC status message subscription"
  default 1
  range 0 63
  depends on SPINALI_SYNAPSE_VESC_CAN_STATUS
  help
    bitmask for SPINALI_SYNAPSE_VESC CAN 3 status messages [ STAT6 STAT5 STAT4 STAT3 STAT2 STAT1 ]
    IE setting status message 4 and 1 would be 0b001001 = 9
    If no status desired set to 0 for it to skip

endmenu

endif # SPINALI_SYNAPSE_VESC_CAN_NUMBER > 3

if SPINALI_SYNAPSE_VESC_CAN_NUMBER > 4

menu "SPINALI_SYNAPSE_VESC_CAN_4"

config SPINALI_SYNAPSE_VESC_CAN_BUS_ALIAS_CAN_N_4
  int "CAN bus alias CAN# for SPINALI_SYNAPSE_VESC 4"
  default 0
  depends on SPINALI_ACTUATE_VESC_CAN || SPINALI_SYNAPSE_VESC_CAN_STATUS
  help
    CAN bus device alias name can(number) that connects to SPINALI_SYNAPSE_VESC 4.

config SPINALI_SYNAPSE_VESC_CAN_BUS_FD_4
  bool "CAN bus is CANFD for SPINALI_SYNAPSE_VESC 4"
  depends on SPINALI_ACTUATE_VESC_CAN || SPINALI_SYNAPSE_VESC_CAN_STATUS
  depends on CAN_FD_MODE
  help
    This option sets the CAN bus to use CANFD for 
    device bus

config SPINALI_SYNAPSE_VESC_POLE_PAIR_4
  int "Number of Pole Pairs of motor attached to SPINALI_SYNAPSE_VESC 4"
  default 15
  range 1 128
  depends on SPINALI_ACTUATE_VESC_CAN || SPINALI_SYNAPSE_VESC_CAN_STATUS
  help
    Number of Pole Pairs of motor attached to SPINALI_SYNAPSE_VESC 4.

config SPINALI_SYNAPSE_VESC_CAN_ID_4
  int "ID of SPINALI_SYNAPSE_VESC 4"
  default 4
  range 0 255
  depends on SPINALI_ACTUATE_VESC_CAN || SPINALI_SYNAPSE_VESC_CAN_STATUS
  help
    ID assigned to SPINALI_SYNAPSE_VESC 4.

config SPINALI_SYNAPSE_VESC_CAN_ACTUATOR_VEL_IDX_4
  int "Actuator velocity index for SPINALI_SYNAPSE_VESC 4"
  default 4
  range 0 15
  depends on SPINALI_ACTUATE_VESC_CAN
  help
    Actuator velocity index for SPINALI_SYNAPSE_VESC 4.

config SPINALI_SYNAPSE_VESC_STATUS_BITMASK_4
  int "bitmask for SPINALI_SYNAPSE_VESC status message subscription"
  default 1
  range 0 63
  depends on SPINALI_SYNAPSE_VESC_CAN_STATUS
  help
    bitmask for SPINALI_SYNAPSE_VESC CAN 4 status messages [ STAT6 STAT5 STAT4 STAT3 STAT2 STAT1 ]
    IE setting status message 4 and 1 would be 0b001001 = 9
    If no status desired set to 0 for it to skip

endmenu

endif # SPINALI_SYNAPSE_VESC_CAN_NUMBER > 4

if SPINALI_SYNAPSE_VESC_CAN_NUMBER > 5

menu "SPINALI_SYNAPSE_VESC_CAN_5"

config SPINALI_SYNAPSE_VESC_CAN_BUS_ALIAS_CAN_N_5
  int "CAN bus alias CAN# for SPINALI_SYNAPSE_VESC 5"
  default 0
  depends on SPINALI_ACTUATE_VESC_CAN || SPINALI_SYNAPSE_VESC_CAN_STATUS
  help
    CAN bus device alias name can(number) that connects to SPINALI_SYNAPSE_VESC 5.

config SPINALI_SYNAPSE_VESC_CAN_BUS_FD_5
  bool "CAN bus is CANFD for SPINALI_SYNAPSE_VESC 5"
  depends on SPINALI_ACTUATE_VESC_CAN || SPINALI_SYNAPSE_VESC_CAN_STATUS
  depends on CAN_FD_MODE
  help
    This option sets the CAN bus to use CANFD for 
    device bus

config SPINALI_SYNAPSE_VESC_POLE_PAIR_5
  int "Number of Pole Pairs of motor attached to SPINALI_SYNAPSE_VESC 5"
  default 15
  range 1 128
  depends on SPINALI_ACTUATE_VESC_CAN || SPINALI_SYNAPSE_VESC_CAN_STATUS
  help
    Number of Pole Pairs of motor attached to SPINALI_SYNAPSE_VESC 5.

config SPINALI_SYNAPSE_VESC_CAN_ID_5
  int "ID of SPINALI_SYNAPSE_VESC 5"
  default 5
  range 0 255
  depends on SPINALI_ACTUATE_VESC_CAN || SPINALI_SYNAPSE_VESC_CAN_STATUS
  help
    ID assigned to SPINALI_SYNAPSE_VESC 5.

config SPINALI_SYNAPSE_VESC_CAN_ACTUATOR_VEL_IDX_5
  int "Actuator velocity index for SPINALI_SYNAPSE_VESC 5"
  default 5
  range 0 15
  depends on SPINALI_ACTUATE_VESC_CAN
  help
    Actuator velocity index for SPINALI_SYNAPSE_VESC 5.

config SPINALI_SYNAPSE_VESC_STATUS_BITMASK_5
  int "bitmask for SPINALI_SYNAPSE_VESC status message subscription"
  default 1
  range 0 63
  depends on SPINALI_SYNAPSE_VESC_CAN_STATUS
  help
    bitmask for SPINALI_SYNAPSE_VESC CAN 5 status messages [ STAT6 STAT5 STAT4 STAT3 STAT2 STAT1 ]
    IE setting status message 4 and 1 would be 0b001001 = 9
    If no status desired set to 0 for it to skip

endmenu

endif # SPINALI_SYNAPSE_VESC_CAN_NUMBER > 5

if SPINALI_SYNAPSE_VESC_CAN_NUMBER > 6

menu "SPINALI_SYNAPSE_VESC_CAN_6"

config SPINALI_SYNAPSE_VESC_CAN_BUS_ALIAS_CAN_N_6
  int "CAN bus alias CAN# for SPINALI_SYNAPSE_VESC 6"
  default 0
  depends on SPINALI_ACTUATE_VESC_CAN || SPINALI_SYNAPSE_VESC_CAN_STATUS
  help
    CAN bus device alias name can(number) that connects to SPINALI_SYNAPSE_VESC 6.

config SPINALI_SYNAPSE_VESC_CAN_BUS_FD_6
  bool "CAN bus is CANFD for SPINALI_SYNAPSE_VESC 6"
  depends on SPINALI_ACTUATE_VESC_CAN || SPINALI_SYNAPSE_VESC_CAN_STATUS
  depends on CAN_FD_MODE
  help
    This option sets the CAN bus to use CANFD for 
    device bus

config SPINALI_SYNAPSE_VESC_POLE_PAIR_6
  int "Number of Pole Pairs of motor attached to SPINALI_SYNAPSE_VESC 6"
  default 15
  range 1 128
  depends on SPINALI_ACTUATE_VESC_CAN || SPINALI_SYNAPSE_VESC_CAN_STATUS
  help
    Number of Pole Pairs of motor attached to SPINALI_SYNAPSE_VESC 6.

config SPINALI_SYNAPSE_VESC_CAN_ID_6
  int "ID of SPINALI_SYNAPSE_VESC 6"
  default 6
  range 0 255
  depends on SPINALI_ACTUATE_VESC_CAN || SPINALI_SYNAPSE_VESC_CAN_STATUS
  help
    ID assigned to SPINALI_SYNAPSE_VESC 6.

config SPINALI_SYNAPSE_VESC_CAN_ACTUATOR_VEL_IDX_6
  int "Actuator velocity index for SPINALI_SYNAPSE_VESC 6"
  default 6
  range 0 15
  depends on SPINALI_ACTUATE_VESC_CAN
  help
    Actuator velocity index for SPINALI_SYNAPSE_VESC 6.

config SPINALI_SYNAPSE_VESC_STATUS_BITMASK_6
  int "bitmask for SPINALI_SYNAPSE_VESC status message subscription"
  default 1
  range 0 63
  depends on SPINALI_SYNAPSE_VESC_CAN_STATUS
  help
    bitmask for SPINALI_SYNAPSE_VESC CAN 6 status messages [ STAT6 STAT5 STAT4 STAT3 STAT2 STAT1 ]
    IE setting status message 4 and 1 would be 0b001001 = 9
    If no status desired set to 0 for it to skip

endmenu

endif # SPINALI_SYNAPSE_VESC_CAN_NUMBER > 6

if SPINALI_SYNAPSE_VESC_CAN_NUMBER > 7

menu "SPINALI_SYNAPSE_VESC_CAN_7"

config SPINALI_SYNAPSE_VESC_CAN_BUS_ALIAS_CAN_N_7
  int "CAN bus alias CAN# for SPINALI_SYNAPSE_VESC 7"
  default 0
  depends on SPINALI_ACTUATE_VESC_CAN || SPINALI_SYNAPSE_VESC_CAN_STATUS
  help
    CAN bus device alias name can(number) that connects to SPINALI_SYNAPSE_VESC 7.

config SPINALI_SYNAPSE_VESC_CAN_BUS_FD_7
  bool "CAN bus is CANFD for SPINALI_SYNAPSE_VESC 7"
  depends on SPINALI_ACTUATE_VESC_CAN || SPINALI_SYNAPSE_VESC_CAN_STATUS
  depends on CAN_FD_MODE
  help
    This option sets the CAN bus to use CANFD for 
    device bus

config SPINALI_SYNAPSE_VESC_POLE_PAIR_7
  int "Number of Pole Pairs of motor attached to SPINALI_SYNAPSE_VESC 7"
  default 15
  range 1 128
  depends on SPINALI_ACTUATE_VESC_CAN || SPINALI_SYNAPSE_VESC_CAN_STATUS
  help
    Number of Pole Pairs of motor attached to SPINALI_SYNAPSE_VESC 7.

config SPINALI_SYNAPSE_VESC_CAN_ID_7
  int "ID of SPINALI_SYNAPSE_VESC 7"
  default 7
  range 0 255
  depends on SPINALI_ACTUATE_VESC_CAN || SPINALI_SYNAPSE_VESC_CAN_STATUS
  help
    ID assigned to SPINALI_SYNAPSE_VESC 7.

config SPINALI_SYNAPSE_VESC_CAN_ACTUATOR_VEL_IDX_7
  int "Actuator velocity index for SPINALI_SYNAPSE_VESC 7"
  default 7
  range 0 15
  depends on SPINALI_ACTUATE_VESC_CAN
  help
    Actuator velocity index for SPINALI_SYNAPSE_VESC 7.

config SPINALI_SYNAPSE_VESC_STATUS_BITMASK_7
  int "bitmask for SPINALI_SYNAPSE_VESC status message subscription"
  default 1
  range 0 63
  depends on SPINALI_SYNAPSE_VESC_CAN_STATUS
  help
    bitmask for SPINALI_SYNAPSE_VESC CAN 7 status messages [ STAT6 STAT5 STAT4 STAT3 STAT2 STAT1 ]
    IE setting status message 4 and 1 would be 0b001001 = 9
    If no status desired set to 0 for it to skip

endmenu

endif # SPINALI_SYNAPSE_VESC_CAN_NUMBER > 7

endif # SPINALI_ACTUATE_VESC_CAN
```

## lib/core/common/Kconfig
```kconfig
# Copyright (c) 2023, CogniPilot Foundation
# SPDX-License-Identifier: Apache-2.0
menuconfig SPINALI_CORE_COMMON
  bool "Enable core common"
  default y
  select ZROS_PERF
  help
     This option enables the core common library

if SPINALI_CORE_COMMON

config SPINALI_CORE_COMMON_BOOT_BANNER
  bool "Enable the boot banner"
  help
    Enable the boot banner

module = SPINALI_CORE_COMMON
module-str = core_common
source "subsys/logging/Kconfig.template.log_config"

endif # SPINALI_CORE_COMMON
```
