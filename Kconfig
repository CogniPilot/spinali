## Kconfig
```kconfig
# Copyright (c) 2023, CogniPilot Foundation
# SPDX-License-Identifier: Apache-2.0

menuconfig SPINALI
  bool "SPINALI"
  default n
  help
    This option enables spinali builds

if SPINALI

menu "Version"

config SPINALI_BOOT_BANNER
  bool "spinali boot banner"
  default y
  help
    Enable spinali boot banner

config SPINALI_APP_NAME
  string "spinali app name"
  help
    This spinali app name

config SPINALI_VERSION_MAJOR
  int "major version"
  default 0
  help
    This spinali major version

config SPINALI_VERSION_MINOR
  int "minor version"
  default 1
  help
    This spinali minor version

config SPINALI_VERSION_PATCH
  int "patch version"
  default 0
  help
    This spinali patch version

endmenu

rsource "./lib/Kconfig"
rsource "./drivers/Kconfig"

endif #SPINALI
```

## drivers/Kconfig
```kconfig
# Copyright (c) 2023 CogniPilot Foundation
# SPDX-License-Identifier: Apache-2.0

menu "Drivers"

rsource "*/Kconfig"

endmenu
```

## drivers/actuate/dshot/Kconfig
```kconfig
# Copyright (c) 2024, CogniPilot Foundation
# SPDX-License-Identifier: Apache-2.0

menuconfig SPINALI_ACTUATE_DSHOT
  bool "DShot"
  depends on ZROS
  default y if DT_HAS_SPINALI_DSHOT_ACTUATORS_ENABLED
  help
    This option enables dshot actuators

if SPINALI_ACTUATE_DSHOT

config SPINALI_ACTUATE_DSHOT_SHELL
  bool "Enable shell"
  help
    Enable shell

module = SPINALI_ACTUATE_DSHOT
module-str = actuate_dshot
source "subsys/logging/Kconfig.template.log_config"

endif #SPINALI_ACTUATE_DSHOT
```

## drivers/actuate/led_array/Kconfig
```kconfig
# Copyright (c) 2023, CogniPilot Foundation
# SPDX-License-Identifier: Apache-2.0

menuconfig SPINALI_ACTUATE_LED_ARRAY
  bool "LED ARRAY"
  help
    This option enables the LED ARRAY

if SPINALI_ACTUATE_LED_ARRAY

config SPINALI_ACTUATE_LED_ARRAY_COUNT
  int "Number of LEDs in array"
  default 12
  range 1 255
  help
    Defines number of LEDS in array



module = SPINALI_ACTUATE_LED_ARRAY
module-str = actuate_led_array
source "subsys/logging/Kconfig.template.log_config"

endif #SPINALI_ACTUATE_LED_ARRAY
```

## drivers/actuate/pwm/Kconfig
```kconfig
# Copyright (c) 2023, CogniPilot Foundation
# SPDX-License-Identifier: Apache-2.0

menuconfig SPINALI_ACTUATE_PWM
  bool "PWM"
  depends on PWM
  depends on ZROS
  default y if DT_HAS_SPINALI_PWM_ACTUATORS_ENABLED
  help
    This option enables pwm actuators

if SPINALI_ACTUATE_PWM

config SPINALI_ACTUATE_PWM_SHELL
  bool "Enable shell"
  help
    Enable shell

module = SPINALI_ACTUATE_PWM
module-str = actuate_pwm
source "subsys/logging/Kconfig.template.log_config"

endif #SPINALI_ACTUATE_PWM
```

## drivers/actuate/sound/Kconfig
```kconfig
# Copyright (c) 2023, CogniPilot Foundation
# SPDX-License-Identifier: Apache-2.0

menuconfig SPINALI_ACTUATE_SOUND
  bool "SOUND"
  depends on PWM
  help
    This option enables sound tones

if SPINALI_ACTUATE_SOUND

module = SPINALI_ACTUATE_SOUND
module-str = actuate_sound
source "subsys/logging/Kconfig.template.log_config"

endif #SPINALI_ACTUATE_SOUND
```

## drivers/actuate/status_led/Kconfig
```kconfig
# Copyright (c) 2023, CogniPilot Foundation
# SPDX-License-Identifier: Apache-2.0

menuconfig SPINALI_ACTUATE_STATUS_LED
  bool "STATUS LED"
  help
    This option enables the status LED

if SPINALI_ACTUATE_STATUS_LED

module = SPINALI_ACTUATE_STATUS_LED
module-str = actuate_status_led
source "subsys/logging/Kconfig.template.log_config"

endif #SPINALI_ACTUATE_STATUS_LED
```

## drivers/actuate/vesc_can/Kconfig
```kconfig
# Copyright (c) 2023, CogniPilot Foundation
# SPDX-License-Identifier: Apache-2.0

menuconfig SPINALI_ACTUATE_VESC_CAN
  bool "VESC_CAN"
  depends on CAN
  depends on ZROS
  default y if DT_HAS_SPINALI_VESC_CAN_ACTUATORS_ENABLED
  help
    This option enables vesc_can actuators

if SPINALI_ACTUATE_VESC_CAN

config SPINALI_ACTUATE_VESC_CAN_SHELL
  bool "Enable shell"
  help
    Enable shell

module = SPINALI_ACTUATE_VESC_CAN
module-str = actuate_vesc_can
source "subsys/logging/Kconfig.template.log_config"

endif #SPINALI_ACTUATE_VESC_CAN
```

## drivers/sense/accel/Kconfig
```kconfig
# Copyright (c) 2023, CogniPilot Foundation
# SPDX-License-Identifier: Apache-2.0
menuconfig SPINALI_SENSE_ACCEL
  bool "ACCEL"
  depends on SPINALI_CORE_COMMON
  depends on ZROS
  help
    This option enables the ACCEL driver interface

if SPINALI_SENSE_ACCEL

config SPINALI_SENSE_ACCEL_COUNT
  int "Number of accelerometers"
  default 1
  range 1 4
  help
    Defines number of accelerometers 1-4

module = SPINALI_SENSE_ACCEL
module-str = sense_accel
source "subsys/logging/Kconfig.template.log_config"

endif # SPINALI_SENSE_ACCEL
```

## drivers/sense/baro/Kconfig
```kconfig
# Copyright (c) 2023, CogniPilot Foundation
# SPDX-License-Identifier: Apache-2.0
menuconfig SPINALI_SENSE_BARO
  bool "Baro"
  help
    This option enables the barometric altimeter driver interface

if SPINALI_SENSE_BARO

config SPINALI_SENSE_BARO_COUNT
  int "Number of barometers"
  default 1
  range 1 4
  help
    Defines number of barometers 1-4

module = SPINALI_SENSE_BARO
module-str = sense_baro
source "subsys/logging/Kconfig.template.log_config"

endif # SPINALI_SENSE_BARO
```

## drivers/sense/icm42688/Kconfig
```kconfig
# Copyright (c) 2023, CogniPilot Foundation
# SPDX-License-Identifier: Apache-2.0
menuconfig SPINALI_SENSE_ICM42688
  bool "ICM42688"
  depends on SPINALI_CORE_COMMON
  depends on ZROS
  help
    This option enables the ICM42688 driver interface

if SPINALI_SENSE_ICM42688

module = SPINALI_SENSE_ICM42688
module-str = sense_accel
source "subsys/logging/Kconfig.template.log_config"

endif # SPINALI_SENSE_ICM42688
```

## drivers/sense/imu/Kconfig
```kconfig
# Copyright (c) 2023, CogniPilot Foundation
# SPDX-License-Identifier: Apache-2.0
menuconfig SPINALI_SENSE_IMU
  bool "IMU"
  default y
  depends on SPINALI_CORE_COMMON
  depends on ZROS
  help
    This option enables the IMU driver interface

if SPINALI_SENSE_IMU

config SPINALI_SENSE_IMU_ACCEL_COUNT
  int "Number of accelerometers"
  default 1
  range 1 4
  help
    Defines number of accelerometers 1-4

config SPINALI_SENSE_IMU_GYRO_COUNT
  int "Number of gyroscopes"
  default 1
  range 1 4
  help
    Defines number of gyroscopes 1-4

module = SPINALI_SENSE_IMU
module-str = sense_imu
source "subsys/logging/Kconfig.template.log_config"

endif # SPINALI_SENSE_IMU
```

## drivers/sense/power/Kconfig
```kconfig
# Copyright (c) 2023, CogniPilot Foundation
# SPDX-License-Identifier: Apache-2.0

menuconfig SPINALI_SENSE_POWER
  bool "Power"
  depends on ZROS
  help
    This option enables power sensor.

if SPINALI_SENSE_POWER

module = SPINALI_SENSE_POWER
module-str = sense_power
source "subsys/logging/Kconfig.template.log_config"

endif # SPINALI_SENSE_POWER
```

## drivers/sense/safety/Kconfig
```kconfig
# Copyright (c) 2023, CogniPilot Foundation
# SPDX-License-Identifier: Apache-2.0
menuconfig SPINALI_SENSE_SAFETY
  bool "Safety"
  default y
  depends on ZROS
  depends on SPINALI_CORE_WORKQUEUES
  help
    This option enables the safety interface

if SPINALI_SENSE_SAFETY

module = SPINALI_SENSE_SAFETY
module-str = sense_safety
source "subsys/logging/Kconfig.template.log_config"

endif # SPINALI_SENSE_SAFETY
```

## drivers/sense/sbus/Kconfig
```kconfig
# Copyright (c) 2023, CogniPilot Foundation
# SPDX-License-Identifier: Apache-2.0
menuconfig SPINALI_SENSE_SBUS
  bool "Input"
  default y
  depends on ZROS
  depends on SPINALI_CORE_WORKQUEUES
  help
    This option enables the safety interface

if SPINALI_SENSE_SBUS

module = SPINALI_SENSE_SBUS
module-str = sense_sbus
source "subsys/logging/Kconfig.template.log_config"

endif # SPINALI_SENSE_SBUS
```

## drivers/sense/vesc_can_status/Kconfig
```kconfig
# Copyright (c) 2023, CogniPilot Foundation
# SPDX-License-Identifier: Apache-2.0

menuconfig SPINALI_SENSE_VESC_CAN_STATUS
  bool "Sense VESC CAN STATUS"
  help
    This option enables vesc can status

if SPINALI_SENSE_VESC_CAN_STATUS

module = SPINALI_SENSE_VESC_CAN_STATUS
module-str = sense_vesc_can_status
source "subsys/logging/Kconfig.template.log_config"

endif # SPINALI_SENSE_VESC_CAN_STATUS
```

## drivers/sense/wheel_odometry/Kconfig
```kconfig
# Copyright (c) 2023, CogniPilot Foundation
# SPDX-License-Identifier: Apache-2.0
menuconfig SPINALI_SENSE_WHEEL_ODOMETRY
  bool "Wheel Odometry"
  depends on ZROS
  depends on SPINALI_CORE_COMMON
  depends on SYNAPSE_PB
  help
    This option enables the wheel odometry driver interface

if SPINALI_SENSE_WHEEL_ODOMETRY

module = SPINALI_SENSE_WHEEL_ODOMETRY
module-str = sense_wheel_odometry
source "subsys/logging/Kconfig.template.log_config"

endif # SPINALI_SENSE_WHEEL_ODOMETRY
```

## drivers/synapse/eth_rx/Kconfig
```kconfig
# Copyright (c) 2024, CogniPilot Foundation
# SPDX-License-Identifier: Apache-2.0

config SPINALI_SYNAPSE_ETH_RX
  bool "ethernet rx"	
  default y
  depends on ZROS
  help
    This option enables the synapse udp interface

if SPINALI_SYNAPSE_ETH_RX

module = SPINALI_SYNAPSE_ETH_RX
module-str = synapse_eth_rx
source "subsys/logging/Kconfig.template.log_config"

endif # SPINALI_SYNAPSE_ETH_RX
```

## drivers/synapse/mcumgr_hooks/Kconfig
```kconfig
# Copyright (c) 2025 CogniPilot Foundation
# SPDX-License-Identifier: Apache-2.0

config SPINALI_SYNAPSE_MCUMGR_HOOKS
	bool "MCUmgr custom hooks"
	default n
	depends on MCUMGR_GRP_OS_INFO_CUSTOM_HOOKS
	depends on HWINFO
	help
	  This option enables custom MCUmgr hooks for hardware identification.
	  Adds support for the 'h' format character in OS info queries to
	  return the chip's unique hardware ID.

if SPINALI_SYNAPSE_MCUMGR_HOOKS

module = SPINALI_SYNAPSE_MCUMGR_HOOKS
module-str = synapse_mcumgr_hooks
source "subsys/logging/Kconfig.template.log_config"

endif # SPINALI_SYNAPSE_MCUMGR_HOOKS

# HCDF Management Group
menuconfig MCUMGR_GRP_HCDF
	bool "MCUmgr HCDF management group"
	default n
	depends on MCUMGR
	select MCUMGR_SMP_CBOR_MIN_DECODING_LEVEL_2
	help
	  Enables MCUmgr handlers for HCDF (Hardware Configuration Descriptive
	  Format) management. This allows Dendrite to query the device's HCDF
	  URL and content hash for 3D visualization.

if MCUMGR_GRP_HCDF

config MCUMGR_GRP_HCDF_URL
	string "HCDF URL"
	default ""
	help
	  The URL where this device's HCDF file can be fetched.
	  Format: https://hcdf.cognipilot.org/{board}/{device}/{device}.hcdf
	  Example: https://hcdf.cognipilot.org/mr_mcxn_t1/optical-flow/optical-flow.hcdf

config MCUMGR_GRP_HCDF_SHA
	string "HCDF SHA256 hash (short)"
	default ""
	help
	  The first 8 characters of the SHA256 hash of the HCDF file content.
	  This allows Dendrite to skip fetching if the cached version matches.
	  The SHA can be found in the HCDF filename (e.g., a8321a14-optical-flow.hcdf).
	  If empty, Dendrite will always fetch the latest version.

config MCUMGR_GRP_HCDF_URL_MAX_LEN
	int "Maximum HCDF URL length"
	default 256
	help
	  Maximum length of the HCDF URL string.

module = MCUMGR_GRP_HCDF
module-str = mcumgr_grp_hcdf
source "subsys/logging/Kconfig.template.log_config"

endif # MCUMGR_GRP_HCDF
```

## drivers/synapse/topic/Kconfig
```kconfig
# Copyright (c) 2023, CogniPilot Foundation
# SPDX-License-Identifier: Apache-2.0

config SPINALI_SYNAPSE_TOPIC
  bool "Enable synapse topic shell"
  default y
  depends on ZROS
  depends on SHELL
  help
    This option enables the synapse topic shell

if SPINALI_SYNAPSE_TOPIC

module = SPINALI_SYNAPSE_TOPIC
module-str = synapse_topic
source "subsys/logging/Kconfig.template.log_config"

endif  # SPINALI_SYNAPSE_TOPIC
```
