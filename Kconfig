## lib/core/workqueues/Kconfig
```kconfig
# Copyright (c) 2023, CogniPilot Foundation
# SPDX-License-Identifier: Apache-2.0
menuconfig SPINALI_CORE_WORKQUEUES
  bool "Enable core work queues"
  default y
  help
    This option enables the system work queues

if SPINALI_CORE_WORKQUEUES

module = SPINALI_CORE_WORKQUEUES
module-str = core_workqueues
source "subsys/logging/Kconfig.template.log_config"

endif # SPINALI_CORE_WORKQUEUES
```

## tests/afbr_s50_test/testcase.yaml
```yaml
common:
  tags:
    - drivers
    - sensor
tests:
  drivers.sensor.afbr_s50:
    filter: CONFIG_AFBR_S50
    build_only: false
```

## tests/apa102_test/testcase.yaml
```yaml
common:
  tags:
    - drivers
    - sensor
tests:
  drivers.sensor.apa102:
    filter: CONFIG_APA102_STRIP
    build_only: false
```
