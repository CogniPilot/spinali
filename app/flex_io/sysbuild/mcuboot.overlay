/* MCUboot overlay for MR-MCXN-T1 */

/ {
	chosen {
		zephyr,code-partition = &boot_partition;
	};
};

/* Enable UART to pull in lpflexcomm driver (needed for MFD) */
&flexcomm1_lpuart1 {
	status = "okay";
};
