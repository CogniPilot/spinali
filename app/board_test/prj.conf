## CMakeLists.txt
```
#-------------------------------------------------------------------------------
# Zephyr Spinali Application
#
# Copyright (c) 2023 CogniPilot Foundation
# SPDX-License-Identifier: Apache-2.0

#Specify a minimum Cmake version
cmake_minimum_required(VERSION 3.13.1)

find_package(Zephyr REQUIRED HINTS $ENV{ZEPHYR_BASE})

#Give the project a name
project(
  IMU_ICM45686_test
  VERSION 1.0
  DESCRIPTION "ICM45686 test code"
  LANGUAGES C
)

set(flags
  -std=c11
  -Wall
  -Wextra
  -Werror
  -Wstrict-prototypes
  -Waggregate-return
  -Wbad-function-cast
  -Wcast-align
  -Wcast-qual
  -Wfloat-equal
  -Wformat-security
  -Wlogical-op
  -Wmissing-declarations
  -Wmissing-include-dirs
  -Wmissing-prototypes
  -Wnested-externs
  -Wpointer-arith
  -Wredundant-decls
  -Wsequence-point
  -Wshadow
  -Wstrict-prototypes
  -Wswitch
  -Wundef
  -Wunreachable-code
  -Wunused-but-set-parameter
  -Wwrite-strings
  )
string(JOIN " " flags ${flags})

set(SOURCE_FILES
  src/main.c
  )

set_source_files_properties(
  ${SOURCE_FILES}
  PROPERTIES COMPILE_FLAGS
  "${flags}"
  )

target_sources(app PRIVATE ${SOURCE_FILES})

target_include_directories(app SYSTEM BEFORE PRIVATE ${ZEPHYR_BASE}/include ${CMAKE_BINARY_DIR})

# vi: ts=2 sw=2 et
```

## Kconfig
```
# Copyright (c) 2023, CogniPilot Foundation
# SPDX-License-Identifier: Apache-2.0

mainmenu "CogniPilot - SPINALI - BOARD_TEST"
menu "Zephyr"
source "Kconfig.zephyr"
endmenu

menu "IMU ICM45686"

config ENABLE_STREAMING
  bool "enable streaming"
  depends on RTIO
  help
    Enable streaming data from ICM45686

config ENABLE_GYRO
    bool "enable gyroscope"
    help
        Enable gyroscope.

config ENABLE_ACCEL
    bool "enable accelerometer"
    help
        Enable accelerometer

module = SPINALI_OPTICAL_FLOW
module-str = spinali_optical_flow
source "subsys/logging/Kconfig.template.log_config"
endmenu
```

## sample.yaml
```
#
# Copyright (c) 2020 TDK Invensense
#
# SPDX-License-Identifier: Apache-2.0
#

sample:
  name: ICM45686 Sensor Sample
tests:
  sample.sensor.icm42605:
    build_only: true
    platform_allow: nrf52dk/nrf52832
    integration_platforms:
      - nrf52dk/nrf52832
    tags: sensors
```

## prj.conf
```kconfig
#
# Copyright (c) 2019 Nordic Semiconductor ASA
#
# SPDX-License-Identifier: Apache-2.0
#

CONFIG_SPI=y
CONFIG_SENSOR=y
CONFIG_I2C_RTIO=y
```

## boards/mr_mcxn_t1_mcxn947_cpu0.overlay
```dts
/* SPDX-License-Identifier: Apache-2.0 */
/* Copyright 2025 CogniPilot Foundation */

/ {

	aliases {
		hub 	= &icm45686_0;
		optical = &icm45686_1;
	};
};

&icm45686_0 {
	spi-max-frequency = <20000000>;
	accel-pwr-mode = <ICM45686_DT_ACCEL_LN>;
	accel-fs = <ICM45686_DT_ACCEL_FS_32>;
	accel-odr = <ICM45686_DT_ACCEL_ODR_6400>;
	accel-lpf = <ICM45686_DT_ACCEL_LPF_BW_1_32>;
	gyro-pwr-mode = <ICM45686_DT_GYRO_LN>;
	gyro-fs = <ICM45686_DT_GYRO_FS_4000>;
	gyro-odr = <ICM45686_DT_GYRO_ODR_6400>;
	gyro-lpf = <ICM45686_DT_GYRO_LPF_BW_1_32>;
};

&icm45686_1 {
	spi-max-frequency = <20000000>;
	accel-pwr-mode = <ICM45686_DT_ACCEL_LN>;
	accel-fs = <ICM45686_DT_ACCEL_FS_2>;
	accel-odr = <ICM45686_DT_ACCEL_ODR_400>;
	accel-lpf = <ICM45686_DT_ACCEL_LPF_BW_1_32>;
	gyro-pwr-mode = <ICM45686_DT_GYRO_LN>;
	gyro-fs = <ICM45686_DT_GYRO_FS_4000>;
	gyro-odr = <ICM45686_DT_GYRO_ODR_400>;
	gyro-lpf = <ICM45686_DT_GYRO_LPF_BW_1_32>;
};
```

## src/main.c
```c
/*
 * Copyright (c) 2021 Bosch Sensortec GmbH
 *
 * SPDX-License-Identifier: Apache-2.0
 */

#include <zephyr/kernel.h>
#include <zephyr/device.h>
#include <zephyr/drivers/sensor.h>
#include <stdio.h>

#define ICM45686_HUB DT_ALIAS(hub)
#define ICM45686_OPTICAL DT_ALIAS(optical)

int main(void)
{
	// const struct device *const dev = DEVICE_DT_GET_ONE(invensense_icm45686);
	const struct device *const dev = DEVICE_DT_GET(ICM45686_HUB);
	const struct device *const dev2 = DEVICE_DT_GET(ICM45686_OPTICAL);
	struct sensor_value acc[3], gyr[3];
	struct sensor_value acc2[3], gyr2[3];

	if (!device_is_ready(dev)) {
		printf("Device %s is not ready\n", dev->name);
		return 0;
	}

	if (!device_is_ready(dev2))
	{
		printf("Device %s is not ready\n", dev2->name);
		return 0;
	}
	
	printf("Device %p name is %s\n", dev, dev->name);
	printf("Device %p name is %s\n", dev2, dev2->name);

	// int err = sensor_attr_set(dev, SENSOR_CHAN_GYRO_XYZ,
	// 		SENSOR_ATTR_SAMPLING_FREQUENCY,
	// 		&sampling_freq);

	// printf("attritube set error: %d\n", err);

	while (1) {
		/* 10ms period, 100Hz Sampling frequency */
		k_sleep(K_MSEC(100));

		sensor_sample_fetch(dev);
		sensor_sample_fetch(dev2);

		sensor_channel_get(dev, SENSOR_CHAN_ACCEL_XYZ, acc);
		sensor_channel_get(dev, SENSOR_CHAN_GYRO_XYZ, gyr);

		sensor_channel_get(dev2, SENSOR_CHAN_ACCEL_XYZ, acc2);
		sensor_channel_get(dev2, SENSOR_CHAN_GYRO_XYZ, gyr2);

		printf("%s: \t AX: %d.%06d; AY: %d.%06d; AZ: %d.%06d; "
		       "GX: %d.%06d; GY: %d.%06d; GZ: %d.%06d;\n",
			   dev->name,
		       acc[0].val1, acc[0].val2,
		       acc[1].val1, acc[1].val2,
		       acc[2].val1, acc[2].val2,
		       gyr[0].val1, gyr[0].val2,
		       gyr[1].val1, gyr[1].val2,
		       gyr[2].val1, gyr[2].val2);

		printf("%s: AX: %d.%06d; AY: %d.%06d; AZ: %d.%06d; "
		       "GX: %d.%06d; GY: %d.%06d; GZ: %d.%06d;\n",
			   dev2->name,
		       acc2[0].val1, acc2[0].val2,
		       acc2[1].val1, acc2[1].val2,
		       acc2[2].val1, acc2[2].val2,
		       gyr2[0].val1, gyr2[0].val2,
		       gyr2[1].val1, gyr2[1].val2,
		       gyr2[2].val1, gyr2[2].val2);
	}
	return 0;
}
```
