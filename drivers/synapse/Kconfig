## drivers/synapse/Kconfig
```kconfig
# Copyright (c) 2023 CogniPilot Foundation
# SPDX-License-Identifier: Apache-2.0

menu "Synapse"

rsource "topic/Kconfig"
rsource "mcumgr_hooks/Kconfig"
rsource "vehicle_optical_flow/Kconfig"
rsource "wire/Kconfig"
rsource "ros_cdr/Kconfig"
rsource "zenoh/Kconfig"

endmenu
```

## drivers/synapse/csyn/Kconfig
```kconfig
# Copyright CogniPilot Foundation 2025
# SPDX-License-Identifier: Apache-2.0

config SPINALI_SYNAPSE_CSYN
	bool "csyn synapse transport bridge"
	default n
	depends on ZROS
	depends on CSYN
	help
	  Bridge the synapse zros topics to the csyn topic store. Outbound
	  fixed-layout topics (GNSS, gPTP time, and the magnetometer) are
	  subscribed on zros and copied into the csyn store, where the csyn zenoh
	  transport publishes them tagged with the value contract from the pinned
	  synapse_fbs catalog. Inbound RTCM3 corrections are forwarded from the
	  csyn store to the zros rtcm3 topic.

	  This is the csyn-based successor to SPINALI_SYNAPSE_ZENOH: enable one
	  or the other, not both. Leave CSYN_ZROS_BRIDGE off so this bridge is
	  the only path between zros and the csyn store.

if SPINALI_SYNAPSE_CSYN

# Per-topic mesh publish rate caps. Each topic is published only when its source
# exists and its rate here is above zero, so setting a rate to 0 turns that topic
# off. Every topic shares one best-effort multicast TX path, so raise a rate only
# as far as a consumer actually needs.

config SPINALI_SYNAPSE_CSYN_GNSS_RATE_HZ
	int "GNSS fix mesh publish rate (Hz, 0 = off)"
	default 25
	help
	  Upper rate at which the GNSS fix is republished onto the mesh, or 0 to
	  not publish it. The u-blox F9P produces fixes up to 20 Hz, so 25 leaves
	  headroom without dropping fixes.

config SPINALI_SYNAPSE_CSYN_MAG_RATE_HZ
	int "Magnetometer mesh publish rate (Hz, 0 = off)"
	default 25
	help
	  Upper rate at which the magnetometer sample is republished onto the
	  mesh, or 0 to not publish it. The RM3100 samples faster than an attitude
	  estimator needs, so it is downsampled here.

config SPINALI_SYNAPSE_CSYN_TIME_RATE_HZ
	int "Time reference mesh publish rate (Hz, 0 = off)"
	default 5
	help
	  Upper rate at which the gPTP time reference is republished onto the
	  mesh, or 0 to not publish it. It changes about once a second.

config SPINALI_SYNAPSE_CSYN_IMU_RATE_HZ
	int "Raw inertial mesh publish rate (Hz, 0 = off)"
	default 0
	help
	  Upper rate at which raw single inertial samples are published onto the
	  mesh, or 0 (the default) to not publish them. Raw inertial is off by
	  default because at the sensor ODR it is one packet per sample, which
	  saturates the shared best-effort multicast TX path and starves the
	  transport control plane. Prefer the batched InertialBatch path for high
	  rate inertial.

module = SPINALI_SYNAPSE_CSYN
module-str = synapse_csyn
source "subsys/logging/Kconfig.template.log_config"

endif # SPINALI_SYNAPSE_CSYN
```

## drivers/synapse/ros_cdr/Kconfig
```kconfig
# SPDX-License-Identifier: Apache-2.0

config SPINALI_SYNAPSE_ROS_CDR
	bool "ROS 2 CDR mirror over Zenoh"
	default n
	depends on ZROS
	depends on NETWORKING
	depends on NET_IPV6
	depends on NET_VLAN
	depends on ZENOH_PICO
	depends on ZENOH_PICO_MULTI_THREAD
	depends on ZENOH_PICO_PUBLICATION
	depends on ZENOH_PICO_LINK_UDP_UNICAST
	depends on ZENOH_PICO_UNSTABLE_API
	help
	  Publish selected Synapse topics as ROS-compatible CDRv1 mirrors through
	  Zenoh. The direct synapse_wire path remains independent and authoritative.

if SPINALI_SYNAPSE_ROS_CDR

choice SPINALI_SYNAPSE_ROS_CDR_TOPIC
	prompt "ROS CDR mirror topic"
	default SPINALI_SYNAPSE_ROS_CDR_TOPIC_OPTICAL_FLOW if SPINALI_VEHICLE_OPTICAL_FLOW
	default SPINALI_SYNAPSE_ROS_CDR_TOPIC_GNSS_FIX if ZROS_SENSE_GNSS

config SPINALI_SYNAPSE_ROS_CDR_TOPIC_OPTICAL_FLOW
	bool "OpticalFlowVelocity"
	depends on SPINALI_VEHICLE_OPTICAL_FLOW

config SPINALI_SYNAPSE_ROS_CDR_TOPIC_GNSS_FIX
	bool "GnssFix"
	depends on ZROS_SENSE_GNSS

endchoice

config SPINALI_SYNAPSE_ROS_CDR_ROUTER
	string "Zenoh router locator"
	default "udp/[fe80::f22f:74ff:fecc:4a66]:7447#iface=eth0"

config SPINALI_SYNAPSE_ROS_CDR_ROUTER_ADDRESS
	string "Zenoh router IPv6 neighbor address"
	default "fe80::f22f:74ff:fecc:4a66"

config SPINALI_SYNAPSE_ROS_CDR_ROUTER_MAC
	string "Zenoh router Ethernet address"
	default "f0:2f:74:cc:4a:66"

config SPINALI_SYNAPSE_ROS_CDR_VLAN_ID
	int "Application VLAN ID"
	range 1 4094
	default 58

config SPINALI_SYNAPSE_ROS_CDR_RATE_HZ
	int "Mirror rate"
	range 1 1000
	default 20 if SPINALI_SYNAPSE_ROS_CDR_TOPIC_OPTICAL_FLOW
	default 10 if SPINALI_SYNAPSE_ROS_CDR_TOPIC_GNSS_FIX

config SPINALI_SYNAPSE_ROS_CDR_THREAD_STACK_SIZE
	int "CDR mirror publisher stack size"
	range 2048 16384
	default 8192

config SPINALI_SYNAPSE_ROS_CDR_THREAD_PRIORITY
	int "CDR mirror publisher priority"
	default 7

module = SPINALI_SYNAPSE_ROS_CDR
module-str = synapse_ros_cdr
source "subsys/logging/Kconfig.template.log_config"

endif
```

## drivers/synapse/vehicle_optical_flow/Kconfig
```kconfig
# Copyright CogniPilot Foundation 2025
# SPDX-License-Identifier: Apache-2.0

config SPINALI_VEHICLE_OPTICAL_FLOW
	bool "Vehicle Optical Flow Processing"
	default n
	depends on ZROS
	help
	  PX4-style optical flow processing with gyro compensation,
	  coning corrections, and range fusion.

if SPINALI_VEHICLE_OPTICAL_FLOW

config VOF_RATE
	int "Max output rate (Hz)"
	default 70
	help
	  Maximum publication rate for processed optical flow data.

config VOF_SCALE
	int "Flow scale factor (x100)"
	default 100
	help
	  Scale factor applied to accumulated flow. 100 = 1.0x.

config VOF_MAXFRAME
	int "Max usable flow frame period (ms)"
	default 100
	help
	  Longest frame-to-frame period still treated as a valid integration
	  window. A longer period means the flow stream stalled, so the frame
	  covers an unknown span of motion and both it and any partial
	  accumulation are discarded. Keep this above the PAA3905 backup timer
	  so that no-motion frames are not mistaken for a stall.

config VOF_ROT
	int "Sensor rotation (degrees: 0, 90, 180, 270)"
	default 0
	help
	  Yaw rotation of optical flow sensor relative to body frame.

config VOF_MINHGT
	int "Min ground distance (cm)"
	default 7
	help
	  Minimum reliable ground distance in centimeters.

config VOF_MAXHGT
	int "Max ground distance (cm)"
	default 2000
	help
	  Maximum reliable ground distance in centimeters.

config VOF_MAXR
	int "Max flow rate (x100 rad/s)"
	default 800
	help
	  Maximum measurable angular rate. 800 = 8.0 rad/s.

	  From the PAA3905 speed versus height chart, which gives 8.0759 x
	  height m/s for observation modes 0 and 1. Dividing by height leaves
	  8.08 rad/s independent of height.

config VOF_SENS
	int "PAA3905 sensitivity (x100 counts/rad)"
	default 48024
	help
	  Counts per radian of angle subtended at the sensor, for converting
	  reported counts into the angle the boresight swept over the surface.
	  48024 = 480.24 counts/rad.

	  From the PAA3905 resolution formula, with height in metres:

	    CPI = 12.198 / height x (RESOLUTION + 1) x 200 / 8600

	  One count is 1/CPI inches of travel at the surface, so the angle it
	  subtends is 0.0254 / (CPI x height) radians, and height cancels:

	    counts/rad = 12.198 x (RESOLUTION + 1) x (200 / 8600) / 0.0254

	  At the RESOLUTION register default of 42 the middle term is exactly
	  1, leaving 12.198 / 0.0254 = 480.24 counts/rad, or 2.08 mrad per
	  count. Scale this value by (RESOLUTION + 1) x 200 / 8600 if the
	  devicetree resolution property is changed.

module = SPINALI_VEHICLE_OPTICAL_FLOW
module-str = vehicle_optical_flow
source "subsys/logging/Kconfig.template.log_config"

endif # SPINALI_VEHICLE_OPTICAL_FLOW
```

## drivers/synapse/wire/Kconfig
```kconfig
# SPDX-License-Identifier: Apache-2.0

config SPINALI_SYNAPSE_WIRE
	bool "Direct Synapse UDP/IPv6 publisher"
	default n
	depends on ZROS
	depends on NETWORKING
	depends on NET_IPV6
	depends on NET_UDP
	depends on NET_SOCKETS
	depends on NET_VLAN
	help
	  Publish selected fixed-layout Synapse samples through the direct
	  synapse_wire UDP/IPv6 path. This transport does not use Zenoh.

if SPINALI_SYNAPSE_WIRE

choice SPINALI_SYNAPSE_WIRE_TOPIC
	prompt "Direct-wire topic"
	default SPINALI_SYNAPSE_WIRE_TOPIC_OPTICAL_FLOW if SPINALI_VEHICLE_OPTICAL_FLOW
	default SPINALI_SYNAPSE_WIRE_TOPIC_GNSS_FIX if ZROS_SENSE_GNSS

config SPINALI_SYNAPSE_WIRE_TOPIC_OPTICAL_FLOW
	bool "OpticalFlowVelocity"
	depends on SPINALI_VEHICLE_OPTICAL_FLOW

config SPINALI_SYNAPSE_WIRE_TOPIC_GNSS_FIX
	bool "GnssFix"
	depends on ZROS_SENSE_GNSS

endchoice

config SPINALI_SYNAPSE_WIRE_DESTINATION
	string "Destination IPv6 address"
	default "fe80::4:9fff:fe00:150"

config SPINALI_SYNAPSE_WIRE_DESTINATION_MAC
	string "Destination Ethernet address"
	default "02:04:9f:00:01:50"

config SPINALI_SYNAPSE_WIRE_SOURCE_NODE_ID
	int "Source node ID"
	range 1 4294967295
	default 12 if SPINALI_SYNAPSE_WIRE_TOPIC_OPTICAL_FLOW
	default 11 if SPINALI_SYNAPSE_WIRE_TOPIC_GNSS_FIX

config SPINALI_SYNAPSE_WIRE_PORT
	int "UDP port"
	range 1 65535
	default 46010 if SPINALI_SYNAPSE_WIRE_TOPIC_OPTICAL_FLOW
	default 46008 if SPINALI_SYNAPSE_WIRE_TOPIC_GNSS_FIX

config SPINALI_SYNAPSE_WIRE_VLAN_ID
	int "Application VLAN ID"
	range 1 4094
	default 58

config SPINALI_SYNAPSE_WIRE_PCP
	int "Application VLAN priority"
	range 0 7
	default 5

config SPINALI_SYNAPSE_WIRE_RATE_HZ
	int "Maximum publish rate"
	range 1 1000
	default 70 if SPINALI_SYNAPSE_WIRE_TOPIC_OPTICAL_FLOW
	default 10 if SPINALI_SYNAPSE_WIRE_TOPIC_GNSS_FIX

config SPINALI_SYNAPSE_WIRE_THREAD_STACK_SIZE
	int "Direct-wire publisher stack size"
	range 1024 8192
	default 2048

config SPINALI_SYNAPSE_WIRE_THREAD_PRIORITY
	int "Direct-wire publisher priority"
	default 6

module = SPINALI_SYNAPSE_WIRE
module-str = synapse_wire
source "subsys/logging/Kconfig.template.log_config"

endif
```

## drivers/synapse/zenoh/Kconfig
```kconfig
# Copyright CogniPilot Foundation 2025
# SPDX-License-Identifier: Apache-2.0

config SPINALI_SYNAPSE_ZENOH
	bool "Zenoh Transport"
	default n
	depends on ZROS
	help
	  Zenoh transport publishing the synapse optical flow topics as
	  raw fixed-layout structs tagged with their catalog value contract.

if SPINALI_SYNAPSE_ZENOH

choice
	prompt "Zenoh session mode"
	default SPINALI_SYNAPSE_ZENOH_MODE_CLIENT
	help
	  Client mode connects to a zenoh router. Peer mode joins a router-less
	  peer-to-peer mesh and discovers other peers over UDP multicast on the
	  local segment, so no router is needed. Peer mode additionally requires
	  CONFIG_ZENOH_PICO_LINK_UDP_MULTICAST=y and CONFIG_ZENOH_PICO_SCOUTING=y
	  in the build.

config SPINALI_SYNAPSE_ZENOH_MODE_CLIENT
	bool "Client (connect to a router)"

config SPINALI_SYNAPSE_ZENOH_MODE_PEER
	bool "Peer (router-less multicast mesh)"

endchoice

config ZENOH_LOCATOR
	string "Zenoh endpoint locator"
	default "tcp/10.58.0.1:7447" if SPINALI_SYNAPSE_ZENOH_MODE_CLIENT
	default "udp/224.0.0.224:7446" if SPINALI_SYNAPSE_ZENOH_MODE_PEER
	help
	  In client mode, the zenoh router address to connect to. In peer mode,
	  the UDP multicast locator used for peer discovery on the local segment.

config SPINALI_SYNAPSE_ZENOH_NAMESPACE
	string "Deployment namespace for bare catalog keys"
	default ""
	help
	  Optional deployment namespace, for example "cub1": topics using a
	  bare catalog key such as flow publish as <namespace>/<key>. Empty
	  publishes the bare key. Multi-segment namespaces such as "lab/cub1"
	  are allowed; do not use leading or trailing slashes. This must match
	  the namespace the receiving vehicle is configured with.

config SPINALI_SYNAPSE_ZENOH_ARGUS_POINTCLOUD
	bool "Publish the argus per-pixel point cloud"
	default n
	depends on ZROS_SENSE_STREAM_ARGUS
	help
	  Publish the AFBR-S50 per-pixel range and intensity point cloud
	  (catalog key "argus", 328-byte samples at the ranger frame rate) so
	  an offboard consumer can reconstruct the 32-zone depth image. This
	  stream is bandwidth and compute heavy for what is normally a
	  diagnostic view, so leave it off unless something offboard actually
	  consumes it; the fused scalar range already rides on the optical
	  flow topics.

module = SPINALI_SYNAPSE_ZENOH
module-str = synapse_zenoh
source "subsys/logging/Kconfig.template.log_config"

endif # SPINALI_SYNAPSE_ZENOH
```

## lib/timing/Kconfig
```kconfig
# Copyright (c) 2026, CogniPilot Foundation
# SPDX-License-Identifier: Apache-2.0

menuconfig SPINALI_TIMING
  bool "Enable GNSS time discipline"
  default n
  depends on GNSS_U_BLOX_F9P_TIMEPULSE
  depends on COUNTER_CAPTURE
  depends on PTP_CLOCK
  depends on NET_GPTP
  help
    Discipline the Ethernet MAC PTP hardware clock (PHC) to GNSS time.
    A hardware capture of the receiver TIMEPULSE edge is paired with the
    UBX-TIM-TP label of that edge and fed to a 1 Hz PI servo that steers
    the PHC, which also serves gPTP. The servo owns the announced
    grandmaster quality and the UTC/leap time properties, so the node
    advertises GNSS traceability only while it holds it.

if SPINALI_TIMING

config SPINALI_TIMING_TM_AUDIT
  bool "Enable the grandmaster absolute-accuracy audit"
  default y
  depends on GPIO
  help
    Drive a GPIO wired to the receiver EXTINT input at a precisely
    measured PHC time and compare it with the UBX-TIM-TM2 timestamp the
    receiver reports for that same edge. This measures absolute PHC
    versus GNSS error end to end through the hardware, independently of
    the discipline servo. Requires a timemark-gpios property on the
    zephyr,user devicetree node.

endif # SPINALI_TIMING
```

## west.yml
```yaml
# Copyright (c) 2023 CogniPilot Foundation
# SPDX-License-Identifier: Apache-2.0

manifest:

  group-filter:
    - +optional

  self:
    west-commands: scripts/west-commands.yml

  remotes:
    - name: zephyrproject-rtos
      url-base: https://github.com/zephyrproject-rtos
    - name: cognipilot
      url-base: https://github.com/CogniPilot

  projects:
    - name: zephyr
      remote: cognipilot
      west-commands: scripts/west-commands.yml
      revision: 72d5ac4afcbb51a97c253d88d4515a5633ff2840 # platinum-next: step threshold, icm45686 rate limit, crsf hardening
      import:
        - name-allowlist:
          - mbedtls
          - tf-psa-crypto
          - hal_nxp
          - hal_tdk
          - hal_afbr
          - cmsis
          - cmsis_6
          - cmsis-dsp
          - fatfs
          - segger
          - mcuboot
          - zcbor
    - name: zros
      remote: cognipilot
      revision: 4e8a7a53a935b61106a7e3065f74b7bbe2cac28f # convergence
      path: modules/lib/zros
    - name: zros_drivers
      remote: cognipilot
      revision: 967062690c07a38db9ee16d5f7a0767684fb1d4b
      path: modules/lib/zros_drivers
    - name: zephyr_boards
      remote: cognipilot
      revision: 1d7c17e875938082f024e80d114ac82c25aa53a9
      path: modules/lib/zephyr_boards
    - name: hcdf_models
      remote: cognipilot
      revision: 2a06acf56ed127e2d3ae37fc24bb0c37964ef193
      path: modules/lib/hcdf_models
    - name: zenoh-pico
      url: https://github.com/CogniPilot/zenoh-pico.git
      revision: 2019ae3394b79955705f9a78c9f32d76b3b845ce
      path: modules/lib/zenoh-pico
```
